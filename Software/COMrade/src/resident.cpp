/*
   resident.cpp - serial-driven control core.

   The serial ISR (serial.cpp) calls serial_on_rx() after buffering received
   bytes.  We assemble framed commands from the RX ring, dispatch each one
   (screen / keystroke / console / file), and queue the response back over the
   serial TX ring.  No mTCP, no packet driver, no cooperative polling -- so this
   coexists with command execution.

   Wire frame (so we can resync after line noise):
     [0xAB][type:1][reqId:2 LE][len:2 LE][payload:len][crc16:2 LE]
   crc16 = CRC-16-CCITT (poly 0x1021, init 0xFFFF) over the 5 header bytes +
   payload.  SYNC is 0xAB to mark the CRC era; the old 0xAA framing used a weak
   8-bit additive sum that let real-link byte errors slip through as silently
   corrupt data (the bridge auto-detects either format).
   The inner [type][reqId][len][payload] matches comrade/protocol.py.
*/

#include <dos.h>
#include <string.h>

#include "types.h"
#include "resident.h"
#include "serial.h"
#include "proto.h"
#include "screen.h"
#include "keys.h"
#include "capture.h"
#include <conio.h>          /* outp (keyboard-controller reset) */
#include "version.h"        /* COMRADE_VERSION (generated by build.sh) */
#include "fileops.h"
#include "dirlist.h"
#include "hwaccess.h"
#include "dossafe.h"
#include "lzss.h"

#define SYNC      0xAB            /* CRC-16 framing (0xAA was the additive-checksum era) */
#define CHUNK_MAX 1024u
#define INBUF_SZ  2048u
#define OUTBUF_SZ 4300u            /* one max frame (80x25 screen + overhead) */

static uint8_t  inbuf[ INBUF_SZ ];
static unsigned inLen = 0;
static uint8_t  outbuf[ OUTBUF_SZ ];
static uint8_t  cbuf[ OUTBUF_SZ ];               /* scratch for LZSS-compressed payloads */
static uint8_t far *inDosPtr = (uint8_t far *)0;

#define COMPRESS_MIN  48u          /* don't bother compressing tiny payloads */
/* COMP_FLAG (0x40) comes from proto.h -- the shared opcode/flag definitions. */

/* A file op that arrived while DOS was busy: deferred to the INT 28h idle hook
   (DOS issues INT 28h while waiting on console input -- a safe window for the
   file functions).  Only one outstanding at a time. */
static uint8_t  g_pend_buf[ 1300 ];
static unsigned g_pend_len = 0;
static unsigned g_pend_req = 0;
volatile uint8_t g_pend_op = 0;                  /* read by the INT 28h hook (serial.cpp) */

/* ---------------------------------------------------------- LE accessors */

static unsigned rd16( const uint8_t *p ) { return (unsigned)p[0] | ((unsigned)p[1] << 8); }
static uint32_t rd32( const uint8_t *p ) {
  return (uint32_t)p[0] | ((uint32_t)p[1] << 8) | ((uint32_t)p[2] << 16) | ((uint32_t)p[3] << 24);
}
static void wr16( uint8_t *p, unsigned v ) { p[0] = (uint8_t)v; p[1] = (uint8_t)(v >> 8); }
static void wr32( uint8_t *p, uint32_t v ) {
  p[0] = (uint8_t)v; p[1] = (uint8_t)(v >> 8); p[2] = (uint8_t)(v >> 16); p[3] = (uint8_t)(v >> 24);
}

/* ---------------------------------------------------------- frame out */

/* Payload must already be at outbuf+6; fill the frame around it and send.
   Large payloads are LZSS-compressed when it actually shrinks them; the opcode's
   COMP_FLAG then marks the payload as [origLen:2 LE][compressed bytes]. */
/* CRC-16-CCITT (poly 0x1021, init 0xFFFF, MSB-first, no reflection / final XOR)
   over the frame body (op..payload).  Replaces the old 8-bit additive sum, which
   was blind to byte transpositions and ~1/256 of random corruption -- letting
   real serial-link errors pass as silently-wrong data.  Bitwise (no table) keeps
   the resident small; ~8*1042 shifts per max frame is nothing next to 115200 baud.
   Must match comrade/protocol.py crc16(). */
static uint16_t crc16( const uint8_t *p, unsigned n )
{
  uint16_t crc = 0xFFFF;
  unsigned i, b;
  for ( i = 0; i < n; i++ ) {
    crc ^= (uint16_t)( (uint16_t)p[i] << 8 );
    for ( b = 0; b < 8; b++ )
      crc = ( crc & 0x8000 ) ? (uint16_t)( ( crc << 1 ) ^ 0x1021 )
                             : (uint16_t)( crc << 1 );
  }
  return crc;
}

static void send_payload( uint8_t op, unsigned reqId, unsigned plen )
{
  unsigned i;
  uint16_t crc;

  if ( plen >= COMPRESS_MIN ) {
    unsigned clen = lzss_compress( outbuf + 6, plen, cbuf, plen );  /* cap=plen: bail if no win */
    if ( clen && clen + 2 < plen ) {
      wr16( outbuf + 6, plen );                  /* original length */
      for ( i = 0; i < clen; i++ ) outbuf[ 8 + i ] = cbuf[i];
      plen = 2 + clen;
      op |= COMP_FLAG;
    }
  }

  outbuf[0] = SYNC;
  outbuf[1] = op;
  wr16( outbuf + 2, reqId );
  wr16( outbuf + 4, plen );
  crc = crc16( outbuf + 1, 5 + plen );             /* op..payload */
  outbuf[ 6 + plen ] = (uint8_t)( crc & 0xFF );    /* CRC-16 LE trailer */
  outbuf[ 7 + plen ] = (uint8_t)( crc >> 8 );
  serial_tx( outbuf, 8 + plen );
}

static void send_frame( uint8_t op, unsigned reqId, const uint8_t *pay, unsigned plen )
{
  unsigned i;
  for ( i = 0; i < plen; i++ ) outbuf[ 6 + i ] = pay[i];
  send_payload( op, reqId, plen );
}

static void send_error( unsigned reqId, uint8_t code )
{
  uint8_t *p = outbuf + 6;
  p[0] = code; p[1] = 0; p[2] = 0;               /* code + zero-length message */
  send_payload( OP_ERROR, reqId, 3 );
}

static void send_hello( unsigned reqId )
{
  uint8_t *p = outbuf + 6;
  const char *m = "COMRADE/" COMRADE_VERSION;  /* "COMRADE/<git-hash>"; auto-stamped by build.sh */
  unsigned cols = PEEKW( 0x40, 0x4A );
  unsigned rows = (unsigned)PEEKB( 0x40, 0x84 ) + 1;
  unsigned ml = (unsigned)strlen( m );
  if ( cols == 0 || cols > 132 ) cols = 80;
  if ( rows == 0 || rows > 60 )  rows = 25;
  p[0] = PROTO_VER; p[1] = (uint8_t)cols; p[2] = (uint8_t)rows;
  wr16( p + 3, CHUNK_MAX );
  wr16( p + 5, ml );
  memcpy( p + 7, m, ml );
  send_payload( OP_HELLO, reqId, 7 + ml );
}

/* ---------------------------------------------------------- dispatch */

static void emit_screen( unsigned reqId )
{
  unsigned plen = screen_build( outbuf + 6, OUTBUF_SZ - 7 );
  if ( plen == 0 ) { send_error( reqId, ST_OTHER ); return; }
  send_payload( OP_SCREEN_DATA, reqId, plen );
}

static void emit_console( unsigned reqId, const uint8_t *p )
{
  uint32_t since = rd32( p );
  unsigned maxlen = rd16( p + 4 );
  uint8_t *pay = outbuf + 6;
  uint32_t base, next;
  uint8_t  ov;
  unsigned n;
  if ( maxlen > CHUNK_MAX ) maxlen = CHUNK_MAX;
  n = capture_read( since, maxlen, pay + 11, &base, &next, &ov );
  wr32( pay + 0, base ); wr32( pay + 4, next ); pay[8] = ov; wr16( pay + 9, n );
  send_payload( OP_CONSOLE_DATA, reqId, 11 + n );
}

static void copy_path( const uint8_t *p, unsigned pl, char *path, unsigned cap )
{
  if ( pl >= cap ) pl = cap - 1;
  memcpy( path, p, pl );
  path[pl] = 0;
}

static void emit_file_read( unsigned reqId, const uint8_t *p )
{
  char path[ 80 ];
  unsigned pl = rd16( p );
  uint32_t offset = rd32( p + 2 + pl );
  unsigned maxlen = rd16( p + 2 + pl + 4 );
  uint8_t *pay = outbuf + 6;
  uint32_t total;
  uint8_t  st;
  unsigned n;
  if ( maxlen > CHUNK_MAX ) maxlen = CHUNK_MAX;
  copy_path( p + 2, pl, path, sizeof( path ) );
  n = fileops_read( path, offset, maxlen, pay + 11, &total, &st );
  pay[0] = st; wr32( pay + 1, total ); wr32( pay + 5, offset ); wr16( pay + 9, n );
  send_payload( OP_FILE_DATA, reqId, 11 + n );
}

/* FILE_HASH request: [pathlen:2][path].  Reply: [status:1][length:4][crc32:4]. */
static void emit_file_hash( unsigned reqId, const uint8_t *p )
{
  char path[ 80 ];
  unsigned pl = rd16( p );
  uint8_t *pay = outbuf + 6;
  uint32_t crc = 0, len = 0;
  uint8_t  st;
  copy_path( p + 2, pl, path, sizeof( path ) );
  fileops_crc32( path, &crc, &len, &st );
  pay[0] = st; wr32( pay + 1, len ); wr32( pay + 5, crc );
  send_payload( OP_FILE_HASH_OK, reqId, 9 );
}

static void emit_file_write( unsigned reqId, const uint8_t *p )
{
  char path[ 80 ];
  unsigned pl = rd16( p );
  uint8_t  flags  = p[ 2 + pl ];
  uint32_t offset = rd32( p + 2 + pl + 1 );
  unsigned dlen   = rd16( p + 2 + pl + 5 );
  const uint8_t *data = p + 2 + pl + 7;
  uint8_t *pay = outbuf + 6;
  uint8_t st;
  unsigned written;
  copy_path( p + 2, pl, path, sizeof( path ) );
  written = fileops_write( path, flags, offset, data, dlen, &st );
  pay[0] = st; wr32( pay + 1, written );
  send_payload( OP_FILE_WROK, reqId, 5 );
}

/* DIR_LIST request: [pathlen:2][path][start:2].
   DIR_DATA reply:   [count:2][more:1][packed entries...] (see dirlist.h). */
static void emit_dir_list( unsigned reqId, const uint8_t *p )
{
  char path[ 80 ];
  unsigned pl    = rd16( p );
  unsigned start = rd16( p + 2 + pl );
  uint8_t *pay   = outbuf + 6;
  unsigned cnt;
  uint8_t  more;
  unsigned blen;
  copy_path( p + 2, pl, path, sizeof( path ) );
  blen = dir_list( path, start, pay + 3, OUTBUF_SZ - 7 - 3, &cnt, &more );
  wr16( pay, cnt ); pay[2] = more;
  send_payload( OP_DIR_DATA, reqId, 3 + blen );
}

/* FILE_ATTR request: [pathlen:2][path][set:1][attr:1].
   FILE_ATTR_OK reply: [status:1][attr:1] (the resulting attribute byte). */
static void emit_file_attr( unsigned reqId, const uint8_t *p )
{
  char path[ 80 ];
  unsigned pl = rd16( p );
  uint8_t  set  = p[ 2 + pl ];
  uint8_t  attr = p[ 2 + pl + 1 ];
  uint8_t *pay = outbuf + 6;
  uint8_t  st, out;
  copy_path( p + 2, pl, path, sizeof( path ) );
  fileops_attr( path, set, attr, &out, &st );
  pay[0] = st; pay[1] = out;
  send_payload( OP_FILE_ATTR_OK, reqId, 2 );
}

/* Direct memory + I/O access (pure CPU ops, no DOS -> dispatched immediately).
   MEM_READ  req: [addr:4][len:2]       -> MEM_DATA [status:1][addr:4][len:2][data]
   MEM_WRITE req: [addr:4][len:2][data] -> MEM_WROK [status:1][len:2]
   IO_IN     req: [port:2][width:1]     -> IO_DATA  [status:1][width:1][value:4]
   IO_OUT    req: [port:2][width:1][value:4] -> IO_OK [status:1] */
static void emit_mem_read( unsigned reqId, const uint8_t *p )
{
  uint32_t addr = rd32( p );
  unsigned len  = rd16( p + 4 );
  uint8_t *pay  = outbuf + 6;
  if ( len > CHUNK_MAX ) len = CHUNK_MAX;
  pay[0] = ST_OK; wr32( pay + 1, addr ); wr16( pay + 5, len );
  mem_read( addr, len, pay + 7 );
  send_payload( OP_MEM_DATA, reqId, 7 + len );
}

static void emit_mem_write( unsigned reqId, const uint8_t *p )
{
  uint32_t addr = rd32( p );
  unsigned len  = rd16( p + 4 );
  uint8_t *pay  = outbuf + 6;
  mem_write( addr, len, p + 6 );
  pay[0] = ST_OK; wr16( pay + 1, len );
  send_payload( OP_MEM_WROK, reqId, 3 );
}

static void emit_io_in( unsigned reqId, const uint8_t *p )
{
  unsigned port  = rd16( p );
  uint8_t  width = p[2];
  uint8_t *pay   = outbuf + 6;
  if ( width != 1 && width != 2 ) {
    pay[0] = ST_BAD_ARGS; pay[1] = width; wr32( pay + 2, 0 );
  } else {
    pay[0] = ST_OK; pay[1] = width; wr32( pay + 2, io_in( port, width ) );
  }
  send_payload( OP_IO_DATA, reqId, 6 );
}

/* Warm-boot the machine.  Set the BDA reset flag (skip the memory test), pulse
   the 8042 reset line (a real CPU reset -- the most reliable method), and fall
   back to a far jump to the BIOS reset vector.  Used by the self-update flow:
   after a new COMRADE.EXE is written to disk, the box reboots and AUTOEXEC loads
   it. */
static void do_reboot( void )
{
  void ( __far *reset )( void );
  POKEW( 0x40, 0x72, 0x1234 );                    /* 0x1234 = warm boot */
  outp( 0x64, 0xFE );                             /* pulse the keyboard-controller reset line */
  reset = (void ( __far * )( void ))MK_FP( 0xFFFF, 0x0000 );
  reset( );                                        /* fallback; does not return */
}

static void emit_io_out( unsigned reqId, const uint8_t *p )
{
  unsigned port  = rd16( p );
  uint8_t  width = p[2];
  uint32_t value = rd32( p + 3 );
  uint8_t *pay   = outbuf + 6;
  if ( width != 1 && width != 2 ) { pay[0] = ST_BAD_ARGS; }
  else { io_out( port, width, value ); pay[0] = ST_OK; }
  send_payload( OP_IO_OK, reqId, 1 );
}

/* ---- Write guard -------------------------------------------------------
   Compiled-in deny-list of I/O ports that a *scripted/dense* write must not
   touch without an explicit GF_UNSAFE override. These are the PC110 ports where
   a stray write can hang, reset, or power-off the box (so the whole session
   dies) -- not a broad blocklist. Single-shot IO_OUT / MEM_WRITE stay unguarded
   by design; this guards BUS_STIM writes, IDX writes and IO_RMW (see proto.h
   GF_UNSAFE). Reads are never gated. */
typedef struct { uint16_t lo, hi; } port_range;
static const port_range g_deny[] = {
  { 0x0022, 0x0025 },   /* VLSI VL82C420 config: 0x22/23 unlock + 0x24/25 index/data (chipset cfg -> hang) */
  { 0x0074, 0x0076 },   /* VL82C420 SCAMP config index/data (chipset cfg -> hang) */
  { 0x0092, 0x0092 },   /* port A: bit0 = fast CPU reset, bit1 = A20 */
  { 0x00EC, 0x00ED },   /* PC110 power-MCU mailbox (suspend / power-off / battery) */
  { 0x15E8, 0x15EF },   /* EC command mailbox A (0x15E8 data / 0x15EC cmd = power/keyboard micro; Zn cmds) */
  { 0x35E8, 0x35EF },   /* EC block B (0x35EA idx / 0x35EB data; AC/power status regs) */
};
#define DENY_N ( sizeof( g_deny ) / sizeof( g_deny[0] ) )

static int port_write_denied( unsigned port )
{
  unsigned i;
  for ( i = 0; i < DENY_N; i++ )
    if ( port >= g_deny[i].lo && port <= g_deny[i].hi ) return 1;
  return 0;
}

/* BUS_STIM legacy req (10B): [kind:1][target:4][width:1][count:4]
   BUS_STIM full req (17B):   [...10B...][value:4][flags:1][max_ticks:2]
   -> BUS_STIM_OK [status:1][iterations:4][last_value:4].
   kind 0 = io_in, 1 = mem_read (reads, always allowed); 2 = io_out, 3 =
   mem_write (writes, deny-list-gated unless GF_UNSAFE). `value` is the byte/word
   written (write kinds). `max_ticks` bounds wall-clock (0 = uncapped). The loop
   blocks the agent for its duration; the host sizes count/timeout. */
static void emit_bus_stim( unsigned reqId, const uint8_t *p, unsigned plen )
{
  uint8_t  kind  = p[0];
  uint32_t tgt   = rd32( p + 1 );
  uint8_t  width = p[5];
  uint32_t count = rd32( p + 6 );
  uint32_t value = ( plen >= 17 ) ? rd32( p + 10 ) : 0;
  uint8_t  flags = ( plen >= 17 ) ? p[14] : 0;
  uint16_t maxtk = ( plen >= 17 ) ? (uint16_t)rd16( p + 15 ) : 0;
  uint8_t *pay   = outbuf + 6;
  uint32_t last  = 0, iters = 0;
  if ( ( width != 1 && width != 2 ) || kind > 3 ) {
    pay[0] = ST_BAD_ARGS; wr32( pay + 1, 0 ); wr32( pay + 5, 0 );
  } else if ( ( kind == 2 ) && !( flags & GF_UNSAFE ) && port_write_denied( (unsigned)tgt ) ) {
    pay[0] = ST_ACCESS; wr32( pay + 1, 0 ); wr32( pay + 5, 0 );
  } else {
    switch ( kind ) {
      case 0: last = io_in_burst( (unsigned)tgt, width, count, maxtk, &iters ); break;
      case 1: last = mem_read_burst( tgt, width, count, maxtk, &iters );        break;
      case 2: last = io_out_burst( (unsigned)tgt, width, value, count, maxtk, &iters ); break;
      case 3: last = mem_write_burst( tgt, width, value, count, maxtk, &iters );        break;
    }
    pay[0] = ST_OK; wr32( pay + 1, iters ); wr32( pay + 5, last );
  }
  send_payload( OP_BUS_STIM_OK, reqId, 9 );
}

/* IDX req: [subop:1][idx_port:2][data_port:2][width:1][first_index:1][count:1]
            [flags:1][value:1]
   subop 0 = read bank: for i in 0..count-1 { out(idx_port, first+i); read
             data_port } -> IDX_DATA [status:1][count:1][data...]. Only the index
             is written (the standard way to *read* an indexed reg), so this is
             not gated. count 0 is treated as 256 (full 8-bit bank).
   subop 1 = write reg: out(idx_port, first_index); out(data_port, value) ->
             IDX_DATA [status:1][count:1(=1)]. Gated (writes data) unless UNSAFE.
   width applies to the DATA port (1 or 2); index writes are always byte. */
static void emit_idx( unsigned reqId, const uint8_t *p )
{
  uint8_t  subop = p[0];
  unsigned iport = rd16( p + 1 );
  unsigned dport = rd16( p + 3 );
  uint8_t  width = p[5];
  uint8_t  first = p[6];
  unsigned count = p[7];
  uint8_t  flags = p[8];
  uint8_t  value = p[9];
  uint8_t *pay   = outbuf + 6;
  if ( width != 1 && width != 2 ) { pay[0] = ST_BAD_ARGS; pay[1] = 0; send_payload( OP_IDX_DATA, reqId, 2 ); return; }
  if ( subop == 0 ) {                                  /* read bank */
    unsigned i, n = count ? count : 256;
    for ( i = 0; i < n; i++ ) {
      io_out( iport, 1, (uint32_t)( (uint8_t)( first + i ) ) );
      if ( width == 2 ) wr16( pay + 2 + i * 2, (unsigned)io_in( dport, 2 ) );
      else              pay[ 2 + i ] = (uint8_t)io_in( dport, 1 );
    }
    pay[0] = ST_OK; pay[1] = (uint8_t)n;
    send_payload( OP_IDX_DATA, reqId, (unsigned)( 2 + n * width ) );
  } else {                                             /* write reg */
    if ( !( flags & GF_UNSAFE ) && ( port_write_denied( dport ) || port_write_denied( iport ) ) ) {
      pay[0] = ST_ACCESS; pay[1] = 0;
    } else {
      io_out( iport, 1, (uint32_t)first );
      io_out( dport, width, (uint32_t)value );
      pay[0] = ST_OK; pay[1] = 1;
    }
    send_payload( OP_IDX_DATA, reqId, 2 );
  }
}

/* IO_RMW req: [port:2][width:1][value:4][restore_ms:2][flags:1]
   Read old = in(port); write new = out(port,value) [gated unless UNSAFE]; if
   restore_ms>0, spin ~that long then write old back -> a reversible probe write.
   -> RMW_OK [status:1][width:1][old_value:4] (old value always reported). */
static void emit_io_rmw( unsigned reqId, const uint8_t *p )
{
  unsigned port  = rd16( p );
  uint8_t  width = p[2];
  uint32_t value = rd32( p + 3 );
  unsigned rms   = rd16( p + 7 );
  uint8_t  flags = p[9];
  uint8_t *pay   = outbuf + 6;
  uint32_t old   = 0;
  if ( width != 1 && width != 2 ) { pay[0] = ST_BAD_ARGS; pay[1] = width; wr32( pay + 2, 0 ); }
  else if ( !( flags & GF_UNSAFE ) && port_write_denied( port ) ) {
    old = io_in( port, width );                        /* read is safe; report it, refuse the write */
    pay[0] = ST_ACCESS; pay[1] = width; wr32( pay + 2, old );
  } else {
    old = io_in( port, width );
    io_out( port, width, value );
    if ( rms ) {
      volatile uint32_t far *t = (volatile uint32_t far *)MK_FP( 0x0040, 0x006C );
      uint32_t t0 = *t, need = ( (uint32_t)rms + 54u ) / 55u;   /* ms -> ~55ms ticks, round up, >=1 */
      if ( !need ) need = 1;
      while ( ( *t - t0 ) < need ) { /* spin; IRQs stay on */ }
      io_out( port, width, old );                       /* restore */
    }
    pay[0] = ST_OK; pay[1] = width; wr32( pay + 2, old );
  }
  send_payload( OP_RMW_OK, reqId, 6 );
}

/* PIC snapshot: read IMR directly (0x21/0xA1) and IRR/ISR via OCW3 (write
   0x0A/0x0B to 0x20/0xA0 then read it back). OCW3 is a standard read-select, not
   a config change, so this is side-effect-safe. -> PIC_OK [status][6 bytes]. */
static void emit_pic( unsigned reqId )
{
  uint8_t *pay = outbuf + 6;
  uint8_t m_imr = (uint8_t)io_in( 0x21, 1 );
  uint8_t s_imr = (uint8_t)io_in( 0xA1, 1 );
  io_out( 0x20, 1, 0x0A ); pay[1] = (uint8_t)io_in( 0x20, 1 );   /* master IRR */
  io_out( 0x20, 1, 0x0B ); pay[2] = (uint8_t)io_in( 0x20, 1 );   /* master ISR */
  pay[3] = m_imr;
  io_out( 0xA0, 1, 0x0A ); pay[4] = (uint8_t)io_in( 0xA0, 1 );   /* slave IRR */
  io_out( 0xA0, 1, 0x0B ); pay[5] = (uint8_t)io_in( 0xA0, 1 );   /* slave ISR */
  pay[6] = s_imr;
  pay[0] = ST_OK;
  send_payload( OP_PIC_OK, reqId, 7 );
}

/* SAFE: report the compiled-in write-guard deny-list so the host can show/respect
   it. -> SAFE_OK [status:1][nranges:1] then nranges*[lo:2][hi:2]. */
static void emit_safe( unsigned reqId )
{
  uint8_t *pay = outbuf + 6;
  unsigned i;
  pay[0] = ST_OK; pay[1] = (uint8_t)DENY_N;
  for ( i = 0; i < DENY_N; i++ ) {
    wr16( pay + 2 + i * 4, g_deny[i].lo );
    wr16( pay + 4 + i * 4, g_deny[i].hi );
  }
  send_payload( OP_SAFE_OK, reqId, (unsigned)( 2 + DENY_N * 4 ) );
}

/* Safe to call DOS for an out-of-band op right now?  We gate on the InDOS flag
   only.  KNOWN GAP: we do NOT also check the DOS critical-error (INT 24h/ErrMode)
   flag, so this can return true during a critical-error window.  Good enough in
   practice; the textbook gate is InDOS==0 AND critErr==0 (add before hardware). */
static int file_safe_now( void )
{
  return ( inDosPtr != (uint8_t far *)0 ) ? ( *inDosPtr == 0 ) : 0;
}

/* DOS is busy now -- stash the file request for the INT 28h idle hook. */
static void defer_file( uint8_t op, unsigned reqId, const uint8_t *p, unsigned plen )
{
  if ( g_pend_op || plen > sizeof( g_pend_buf ) ) { send_error( reqId, ST_BUSY ); return; }
  memcpy( g_pend_buf, p, plen );
  g_pend_len = plen;
  g_pend_req = reqId;
  g_pend_op  = op;                               /* set last: arms the idle hook */
}

static void dispatch( uint8_t op, unsigned reqId, const uint8_t *p, unsigned plen )
{
  switch ( op ) {
    case OP_PING:       send_hello( reqId );        break;   /* PING -> HELLO probe */
    case OP_SCREEN_GET: emit_screen( reqId );       break;
    case OP_KEYS_SEND: {
      unsigned count = rd16( p );
      unsigned inj   = keys_inject( p + 2, count );
      uint8_t  ack[2];
      wr16( ack, inj );
      send_frame( OP_KEYS_ACK, reqId, ack, 2 );
      break;
    }
    case OP_KEYS_RAW: {                              /* [count:2][raw scancodes] */
      unsigned count = rd16( p );
      unsigned inj   = keys_raw_inject( p + 2, count );
      uint8_t  ack[2];
      wr16( ack, inj );
      send_frame( OP_KEYS_RAW_OK, reqId, ack, 2 );
      break;
    }
    case OP_CONSOLE_GET: emit_console( reqId, p );   break;
    case OP_FILE_READ:
      if ( file_safe_now( ) ) emit_file_read( reqId, p );
      else defer_file( op, reqId, p, plen );
      break;
    case OP_FILE_WRITE:
      if ( file_safe_now( ) ) emit_file_write( reqId, p );
      else defer_file( op, reqId, p, plen );
      break;
    case OP_DIR_LIST:
      if ( file_safe_now( ) ) emit_dir_list( reqId, p );
      else defer_file( op, reqId, p, plen );
      break;
    case OP_FILE_ATTR:
      if ( file_safe_now( ) ) emit_file_attr( reqId, p );
      else defer_file( op, reqId, p, plen );
      break;
    case OP_FILE_HASH:
      if ( file_safe_now( ) ) emit_file_hash( reqId, p );
      else defer_file( op, reqId, p, plen );
      break;
    case OP_MEM_READ:  emit_mem_read( reqId, p );  break;
    case OP_MEM_WRITE: emit_mem_write( reqId, p ); break;
    case OP_IO_IN:     emit_io_in( reqId, p );     break;
    case OP_IO_OUT:    emit_io_out( reqId, p );    break;
    case OP_BUS_STIM:  emit_bus_stim( reqId, p, plen ); break;
    case OP_IDX:       emit_idx( reqId, p );       break;
    case OP_IO_RMW:    emit_io_rmw( reqId, p );    break;
    case OP_PIC:       emit_pic( reqId );          break;
    case OP_SAFE:      emit_safe( reqId );         break;
    case OP_REBOOT:    do_reboot( );               break;   /* never returns */
    default:
      send_error( reqId, ST_BAD_ARGS );
      break;
  }
}

/* Called from serial.cpp's INT 28h hook (on the private ISR stack) when a file
   op was deferred.  DOS is waiting on console input here, so the file functions
   are safe to call. */
void resident_idle( void )
{
  uint8_t op = g_pend_op;
  if ( !op ) return;
  if ( op == OP_FILE_READ )  emit_file_read( g_pend_req, g_pend_buf );
  else if ( op == OP_FILE_WRITE ) emit_file_write( g_pend_req, g_pend_buf );
  else if ( op == OP_DIR_LIST ) emit_dir_list( g_pend_req, g_pend_buf );
  else if ( op == OP_FILE_ATTR ) emit_file_attr( g_pend_req, g_pend_buf );
  else if ( op == OP_FILE_HASH ) emit_file_hash( g_pend_req, g_pend_buf );
  g_pend_op = 0;
}

/* ---------------------------------------------------------- frame parse */

static void parse_frames( void )
{
  unsigned i = 0;
  while ( i < inLen ) {
    unsigned plen, framelen;
    uint8_t  op;
    unsigned reqId;
    uint16_t crc, got;

    if ( inbuf[i] != SYNC ) { i++; continue; }    /* hunt for sync */
    if ( inLen - i < 8 ) break;                   /* need header + crc16 */
    plen = rd16( inbuf + i + 4 );
    if ( plen > INBUF_SZ - 8 ) { i++; continue; } /* bogus length: skip sync */
    framelen = 8 + plen;
    if ( inLen - i < framelen ) break;            /* wait for the rest */

    crc = crc16( inbuf + i + 1, 5 + plen );       /* op..payload */
    got = (uint16_t)inbuf[ i + 6 + plen ] | ( (uint16_t)inbuf[ i + 7 + plen ] << 8 );
    if ( crc != got ) { i++; continue; }          /* bad CRC: resync */

    op    = inbuf[ i + 1 ];
    reqId = rd16( inbuf + i + 2 );
    dispatch( op, reqId, inbuf + i + 6, plen );
    i += framelen;
  }
  /* drop everything we consumed / skipped past */
  if ( i > 0 ) {
    inLen -= i;
    if ( inLen ) memmove( inbuf, inbuf + i, inLen );
  }
}

/* Called by the serial ISR (on a private stack, guarded against re-entry). */
void serial_on_rx( void )
{
  for ( ;; ) {
    int c;
    while ( inLen < INBUF_SZ && ( c = serial_rx_get( ) ) >= 0 ) inbuf[ inLen++ ] = (uint8_t)c;
    parse_frames( );
    /* Do NOT drain deferred keys here: this runs from the serial ISR (incl. the
       TX-complete interrupt), which can fire while the foreground is mid-read of
       the BIOS type-ahead buffer -> racing pointer updates corrupt it and the
       box jumps to ~null and #UDs.  Deferred keys are drained from the INT 28h
       idle hook instead (DOS idle = the foreground is not mid-read). */
    if ( serial_rx_count( ) == 0 ) break;         /* nothing new arrived meanwhile */
  }
}

void resident_setup( unsigned psp )
{
  inDosPtr = getInDosPtr( );
  fileops_set_psp( psp );
  capture_install( );                             /* INT 29h console-stream capture */
  serial_hook_idle( );                            /* INT 28h hook for deferred file I/O */
  send_hello( 0 );                                /* announce ourselves */
}
