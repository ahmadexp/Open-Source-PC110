; ICONS.INC  -  auto-generated by tools/make_icons.py
; 16x16 line-art menu icons (bit set = dark-red art, clear = white tile)

ic_batt:
        dw 0x0000, 0x0000, 0x0000, 0x0000, 0x0000, 0x3FF0, 0x2010, 0x2A98
        dw 0x2A98, 0x2A98, 0x2010, 0x3FF0, 0x0000, 0x0000, 0x0000, 0x0000
ic_disp:
        dw 0x0000, 0x0000, 0x3FFC, 0x2004, 0x2004, 0x2004, 0x2004, 0x2004
        dw 0x2004, 0x2004, 0x3FFC, 0x0180, 0x0180, 0x0FF0, 0x0000, 0x0000
ic_dev:
        dw 0x0000, 0x0000, 0x0240, 0x0240, 0x0FF0, 0x0810, 0x0810, 0x0810
        dw 0x0810, 0x0FF0, 0x0180, 0x0180, 0x0180, 0x0180, 0x0000, 0x0000
ic_kbd:
        dw 0x0000, 0x0000, 0x0000, 0x0000, 0x0000, 0x7FFE, 0x4002, 0x5552
        dw 0x4002, 0x5552, 0x4002, 0x7FFE, 0x0000, 0x0000, 0x0000, 0x0000
ic_adv:
        dw 0x0000, 0x0000, 0x0008, 0x1010, 0x0BC0, 0x0420, 0x0810, 0x4812
        dw 0x4812, 0x0810, 0x0420, 0x03C0, 0x1008, 0x2004, 0x0000, 0x0000
ic_chip:
        dw 0x0000, 0x0000, 0x02A0, 0x02A0, 0x0FF0, 0x0810, 0x781E, 0x0810
        dw 0x781E, 0x0810, 0x781E, 0x0FF0, 0x02A0, 0x02A0, 0x0000, 0x0000
ic_check:
        dw 0x0000, 0x0000, 0x1FF8, 0x13C8, 0x1008, 0x1008, 0x1018, 0x1028
        dw 0x1048, 0x1448, 0x1288, 0x1108, 0x1008, 0x1008, 0x0000, 0x0000
ic_mag:
        dw 0x0000, 0x0000, 0x0F00, 0x1080, 0x2040, 0x2040, 0x2040, 0x2040
        dw 0x1080, 0x0FC0, 0x0060, 0x0030, 0x0018, 0x000C, 0x0000, 0x0000
ic_floppy:
        dw 0x0000, 0x0000, 0x3FFC, 0x27E4, 0x27E4, 0x27E4, 0x2004, 0x2004
        dw 0x27F4, 0x2414, 0x2414, 0x2414, 0x27F4, 0x3FFC, 0x0000, 0x0000
ic_info:
        dw 0x0000, 0x0000, 0x03C0, 0x0C30, 0x1008, 0x1188, 0x2004, 0x2184
        dw 0x2184, 0x2184, 0x1188, 0x1188, 0x0C30, 0x03C0, 0x0000, 0x0000
ic_set:
        dw 0x0000, 0x0000, 0x0000, 0x0070, 0x3FFC, 0x0070, 0x0000, 0x0E00
        dw 0x3FFC, 0x0E00, 0x0000, 0x0038, 0x3FFC, 0x0038, 0x0000, 0x0000
ic_run:
        dw 0x0000, 0x0000, 0x0000, 0x0800, 0x0E00, 0x0980, 0x0860, 0x0818
        dw 0x0804, 0x0818, 0x0860, 0x0980, 0x0E00, 0x0800, 0x0000, 0x0000

; category -> icon (main-menu order, 10 categories)
catic:  dw ic_batt, ic_disp, ic_dev, ic_kbd, ic_adv, ic_chip, ic_check, ic_mag, ic_floppy, ic_info

