; Auto-generated PS2-GUI graphics (crisp narrow title, own credits)

PAL_N equ 5
espal:
  db 46,36,32
  db 62,62,62
  db 28,1,1
  db 2,1,12
  db 0,0,0

esplane0:
  db 255,255,255,255,255,255,255,255,255,255,255,255,255,255,255,255,255,255,255,255,14,255,72,0
  db 8,255,72,0,8,255,72,0,8,255,72,0,8,255,72,0,8,255,72,0,8,255,72,0
  db 8,255,72,0,8,255,72,0,8,255,72,0,8,255,72,0,8,255,72,0,8,255,72,0
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  db 255,255,255,255,255,255,255,255,255,255,150,255
esplane0_end:

esplane1:
  db 255,0,255,0,255,0,255,0,255,0,255,0,255,0,255,0,255,0,255,0,255,0,255,0
  db 255,0,255,0,255,0,255,0,255,0,255,0,255,0,255,0,255,0,255,0,255,0,255,0
  db 255,0,255,0,255,0,255,0,255,0,255,0,255,0,255,0,255,0,255,0,255,0,255,0
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  db 255,0,255,0,255,0,255,0,255,0,255,0,255,0,255,0,221,0
esplane1_end:

esplane2:
  db 255,0,255,0,255,0,255,0,255,0,255,0,255,0,255,0,255,0,255,0,255,0,255,0
  db 255,0,255,0,255,0,255,0,255,0,255,0,255,0,255,0,255,0,255,0,243,0,1,124
  db 4,0,1,15,1,128,70,0,1,63,1,248,1,1,1,254,1,0,1,124,2,0,1,63
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  db 255,0,255,0,255,0,255,0,255,0,255,0,255,0,173,0
esplane2_end:

esplane3:
  db 255,0,255,0,255,0,255,0,255,0,255,0,255,0,255,0,255,0,255,0,255,0,255,0
  db 255,0,255,0,255,0,255,0,255,0,255,0,255,0,255,0,255,0,255,0,255,0,255,0
  db 255,0,255,0,255,0,255,0,255,0,255,0,255,0,255,0,255,0,255,0,255,0,255,0
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  db 255,0,255,0,255,0,255,0,255,0,255,0,150,0
esplane3_end:

esplanes: dw esplane0, esplane1, esplane2, esplane3
esplanelen: dw esplane0_end-esplane0, esplane1_end-esplane1, esplane2_end-esplane2, esplane3_end-esplane3

ICON_N equ 6
icons:
  dw 80,160,143,223   ; Config
  dw 184,160,247,223   ; Date/Time
  dw 288,160,351,223   ; Battery
  dw 392,160,455,223   ; Backup
  dw 496,160,559,223   ; Test
  dw 80,272,143,335   ; Restart
