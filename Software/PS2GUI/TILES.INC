; TILES.INC  -  auto-generated by tools/make_tiles.py
; Easy-Setup tile artwork: detailed 48x48 icons + PS2-GUI title + duck.

tile_cat_power:
        dw 0x0000, 0x0000, 0x0000
        dw 0x0000, 0x0000, 0x0000
        dw 0x0000, 0x0000, 0x0000
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        dw 0x0000, 0x0000, 0x0000
tile_cat_disp:
        dw 0x0000, 0x0000, 0x0000
        dw 0x0000, 0x0000, 0x0000
        dw 0x0000, 0x0000, 0x0000
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        dw 0x0000, 0x0000, 0x0000
tile_cat_dev:
        dw 0x0000, 0x0000, 0x0000
        dw 0x0000, 0x0000, 0x0000
        dw 0x0000, 0x0000, 0x0000
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        dw 0x0000, 0x0000, 0x0000
tile_cat_kbd:
        dw 0x0000, 0x0000, 0x0000
        dw 0x0000, 0x0000, 0x0000
        dw 0x0000, 0x0000, 0x0000
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        dw 0x0000, 0x0000, 0x0000
tile_cat_adv:
        dw 0x0000, 0x0000, 0x0000
        dw 0x0000, 0x0000, 0x0000
        dw 0x0000, 0x0000, 0x0000
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        dw 0x0000, 0x0000, 0x0000
tile_cat_dump:
        dw 0x0000, 0x0000, 0x0000
        dw 0x0000, 0x0000, 0x0000
        dw 0x0000, 0x0000, 0x0000
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        dw 0x0000, 0x0000, 0x0000
tile_cat_test:
        dw 0x0000, 0x0000, 0x0000
        dw 0x0000, 0x0000, 0x0000
        dw 0x0000, 0x0000, 0x0000
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        dw 0x0000, 0x0000, 0x0000
tile_cat_diag:
        dw 0x0000, 0x0000, 0x0000
        dw 0x0000, 0x0000, 0x0000
        dw 0x0000, 0x0000, 0x0000
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        dw 0x0000, 0x0000, 0x0000
tile_cat_backup:
        dw 0x0000, 0x0000, 0x0000
        dw 0x0000, 0x0000, 0x0000
        dw 0x0000, 0x0000, 0x0000
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        dw 0x0000, 0x0000, 0x0000
tile_cat_info:
        dw 0x0000, 0x0000, 0x0000
        dw 0x0000, 0x0000, 0x0000
        dw 0x0000, 0x0000, 0x0000
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        dw 0x0000, 0x0000, 0x0000
tile_leaf:
        dw 0x0000, 0x0000, 0x0000
        dw 0x0000, 0x0000, 0x0000
        dw 0x0000, 0x0000, 0x0000
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        dw 0x0000, 0x0000, 0x0000
tile_moon:
        dw 0x0000, 0x0000, 0x0000
        dw 0x0000, 0x0000, 0x0000
        dw 0x0000, 0x0000, 0x0000
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        dw 0x0000, 0x0000, 0x0000
tile_mon_off:
        dw 0x0000, 0x0000, 0x0000
        dw 0x0000, 0x0000, 0x0000
        dw 0x0000, 0x0000, 0x0000
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        dw 0x0000, 0x0000, 0x0000
tile_gauge:
        dw 0x0000, 0x0000, 0x0000
        dw 0x0000, 0x0000, 0x0000
        dw 0x0000, 0x0000, 0x0000
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        dw 0x0000, 0x0000, 0x0000
tile_clam:
        dw 0x0000, 0x0000, 0x0000
        dw 0x0000, 0x0000, 0x0000
        dw 0x0000, 0x0000, 0x0000
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        dw 0x0000, 0x0000, 0x0000
tile_phone:
        dw 0x0000, 0x0000, 0x0000
        dw 0x0000, 0x0000, 0x0000
        dw 0x0000, 0x0000, 0x0000
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        dw 0x0000, 0x0000, 0x0000
tile_bat_bolt:
        dw 0x0000, 0x0000, 0x0000
        dw 0x0000, 0x0000, 0x0000
        dw 0x0000, 0x0000, 0x0000
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        dw 0x0000, 0x0000, 0x0000
tile_reset:
        dw 0x0000, 0x0000, 0x0000
        dw 0x0000, 0x0000, 0x0000
        dw 0x0000, 0x0000, 0x0000
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        dw 0x0000, 0x0000, 0x0000
tile_dualmon:
        dw 0x0000, 0x0000, 0x0000
        dw 0x0000, 0x0000, 0x0000
        dw 0x0000, 0x0000, 0x0000
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        dw 0x0000, 0x0000, 0x0000
tile_expand:
        dw 0x0000, 0x0000, 0x0000
        dw 0x0000, 0x0000, 0x0000
        dw 0x0000, 0x0000, 0x0000
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        dw 0x0000, 0x0000, 0x0000
tile_speaker:
        dw 0x0000, 0x0000, 0x0000
        dw 0x0000, 0x0000, 0x0000
        dw 0x0000, 0x0000, 0x0000
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        dw 0x0000, 0x0000, 0x0000
tile_wave:
        dw 0x0000, 0x0000, 0x0000
        dw 0x0000, 0x0000, 0x0000
        dw 0x0000, 0x0000, 0x0000
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        dw 0x0000, 0x0000, 0x0000
tile_pen:
        dw 0x0000, 0x0000, 0x0000
        dw 0x0000, 0x0000, 0x0000
        dw 0x0000, 0x0000, 0x0000
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        dw 0x0000, 0x0000, 0x0000
tile_ir:
        dw 0x0000, 0x0000, 0x0000
        dw 0x0000, 0x0000, 0x0000
        dw 0x0000, 0x0000, 0x0000
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        dw 0x0000, 0x0000, 0x0000
tile_serial:
        dw 0x0000, 0x0000, 0x0000
        dw 0x0000, 0x0000, 0x0000
        dw 0x0000, 0x0000, 0x0000
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        dw 0x0000, 0x0000, 0x0000
tile_modem:
        dw 0x0000, 0x0000, 0x0000
        dw 0x0000, 0x0000, 0x0000
        dw 0x0000, 0x0000, 0x0000
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        dw 0x0000, 0x0000, 0x0000
tile_pccard:
        dw 0x0000, 0x0000, 0x0000
        dw 0x0000, 0x0000, 0x0000
        dw 0x0000, 0x0000, 0x0000
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        dw 0x0000, 0x0000, 0x0000
tile_keyboard:
        dw 0x0000, 0x0000, 0x0000
        dw 0x0000, 0x0000, 0x0000
        dw 0x0000, 0x0000, 0x0000
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        dw 0x0000, 0x0000, 0x0000
tile_clock:
        dw 0x0000, 0x0000, 0x0000
        dw 0x0000, 0x0000, 0x0000
        dw 0x0000, 0x0000, 0x0000
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        dw 0x0000, 0x0000, 0x0000
tile_mouse:
        dw 0x0000, 0x0000, 0x0000
        dw 0x0000, 0x0000, 0x0000
        dw 0x0000, 0x0000, 0x0000
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        dw 0x0000, 0x0000, 0x0000
tile_mouse_mag:
        dw 0x0000, 0x0000, 0x0000
        dw 0x0000, 0x0000, 0x0000
        dw 0x0000, 0x0000, 0x0000
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        dw 0x0000, 0x0000, 0x0000
tile_printer:
        dw 0x0000, 0x0000, 0x0000
        dw 0x0000, 0x0000, 0x0000
        dw 0x0000, 0x0000, 0x0000
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        dw 0x0000, 0x0000, 0x0000
tile_hdd:
        dw 0x0000, 0x0000, 0x0000
        dw 0x0000, 0x0000, 0x0000
        dw 0x0000, 0x0000, 0x0000
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        dw 0x0000, 0x0000, 0x0000
tile_battery:
        dw 0x0000, 0x0000, 0x0000
        dw 0x0000, 0x0000, 0x0000
        dw 0x0000, 0x0000, 0x0000
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        dw 0x0000, 0x0000, 0x0000
tile_floppy:
        dw 0x0000, 0x0000, 0x0000
        dw 0x0000, 0x0000, 0x0000
        dw 0x0000, 0x0000, 0x0000
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        dw 0x0000, 0x0000, 0x0000
tile_bolt:
        dw 0x0000, 0x0000, 0x0000
        dw 0x0000, 0x0000, 0x0000
        dw 0x0000, 0x0000, 0x0000
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        dw 0x0000, 0x0000, 0x0000
tile_netring:
        dw 0x0000, 0x0000, 0x0000
        dw 0x0000, 0x0000, 0x0000
        dw 0x0000, 0x0000, 0x0000
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        dw 0x0000, 0x0000, 0x0000
tile_link:
        dw 0x0000, 0x0000, 0x0000
        dw 0x0000, 0x0000, 0x0000
        dw 0x0000, 0x0000, 0x0000
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        dw 0x0000, 0x0000, 0x0000
tile_chip_dl:
        dw 0x0001, 0x8306, 0x0000
        dw 0x0001, 0x8306, 0x0000
        dw 0x0001, 0x8306, 0x0000
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        dw 0x0000, 0x0000, 0x0000
tile_fontA:
        dw 0x0000, 0x0000, 0x0000
        dw 0x0000, 0x0000, 0x0000
        dw 0x0000, 0x0000, 0x0000
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        dw 0x0000, 0x0000, 0x0000
tile_ram:
        dw 0x0000, 0x0000, 0x0000
        dw 0x0000, 0x0000, 0x0000
        dw 0x0000, 0x0000, 0x0000
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        dw 0x0000, 0x0000, 0x0000
tile_mon_color:
        dw 0x0000, 0x0000, 0x0000
        dw 0x0000, 0x0000, 0x0000
        dw 0x0000, 0x0000, 0x0000
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        dw 0x0000, 0x0000, 0x0000
tile_timer:
        dw 0x0000, 0x0000, 0x0000
        dw 0x0000, 0x0000, 0x0000
        dw 0x0000, 0x0000, 0x0000
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        dw 0x0000, 0x0000, 0x0000
tile_mag_list:
        dw 0x0000, 0x0000, 0x0000
        dw 0x0000, 0x0000, 0x0000
        dw 0x0000, 0x0000, 0x0000
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        dw 0x0000, 0x0000, 0x0000
tile_hdd_mag:
        dw 0x0000, 0x0000, 0x0000
        dw 0x0000, 0x0000, 0x0000
        dw 0x0000, 0x0000, 0x0000
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        dw 0x0000, 0x0000, 0x0000
tile_bat_mag:
        dw 0x0000, 0x0000, 0x0000
        dw 0x0000, 0x0000, 0x0000
        dw 0x0000, 0x0000, 0x0000
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        dw 0x0000, 0x0000, 0x0000
tile_card_mag:
        dw 0x0000, 0x0000, 0x0000
        dw 0x0000, 0x0000, 0x0000
        dw 0x0000, 0x0000, 0x0000
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        dw 0x0000, 0x0000, 0x0000
tile_chip_mag:
        dw 0x0006, 0x0C18, 0x0000
        dw 0x0006, 0x0C18, 0x0000
        dw 0x0006, 0x0C18, 0x0000
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        dw 0x0000, 0x0000, 0x0000
tile_save_up:
        dw 0x0000, 0x0000, 0x0000
        dw 0x0000, 0x0000, 0x0000
        dw 0x0000, 0x0000, 0x0000
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        dw 0x0000, 0x0000, 0x0000
tile_save_dn:
        dw 0x0000, 0x0000, 0x0000
        dw 0x0000, 0x0000, 0x0000
        dw 0x0000, 0x0000, 0x0000
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        dw 0x0000, 0x0000, 0x0000
tile_bat_info:
        dw 0x0000, 0x0000, 0x0000
        dw 0x0000, 0x0000, 0x0000
        dw 0x0000, 0x0000, 0x0000
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        dw 0x0000, 0x0000, 0x0000
tile_gear_info:
        dw 0x0000, 0x0000, 0x0000
        dw 0x0000, 0x0000, 0x0000
        dw 0x0000, 0x0000, 0x0000
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        dw 0x0000, 0x0000, 0x0000
tile_tag:
        dw 0x0000, 0x0000, 0x0000
        dw 0x0000, 0x0000, 0x0000
        dw 0x0000, 0x0000, 0x0000
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        dw 0x0000, 0x0000, 0x0000
tile_power:
        dw 0x0000, 0x0000, 0x0000
        dw 0x0000, 0x0000, 0x0000
        dw 0x0000, 0x0000, 0x0000
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        dw 0x0000, 0x0000, 0x0000

tile_title:
        dw 0x0000, 0x000F, 0xF800, 0x07F0, 0x0000, 0x001F, 0xC000, 0x0000, 0x0000
        dw 0xFFFE, 0x003F, 0xFE00, 0x3FFC, 0x0000, 0x00FF, 0xF807, 0xFC7F, 0xC3FE
        dw 0xFFFF, 0x807F, 0xFF80, 0x7FFF, 0x0000, 0x01FF, 0xFC07, 0xFC7F, 0xC3FE
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        dw 0x0000, 0x0007, 0xF800, 0x0000, 0x0000, 0x003E, 0x0000, 0x0FF0, 0x0000
TITLE_WW equ 9
TITLE_H  equ 38

tile_copy:
        dw 0x2000, 0x2000, 0x0000, 0x0000, 0x0000, 0x0000, 0x0000, 0x0000, 0x0000, 0x0000, 0x0000, 0x0003, 0x0000, 0x0000, 0x0000, 0x0000, 0x0000, 0x0000, 0x6000, 0x0000, 0x0000, 0x0000, 0x0000, 0x0000, 0x0000, 0x0000, 0x0000, 0x0000, 0x0000, 0x0000, 0x0000, 0x0000
        dw 0x4078, 0x3000, 0x1E07, 0x0781, 0xE000, 0x70C0, 0x0000, 0x00C0, 0x07E0, 0x0000, 0x0000, 0x0003, 0x0000, 0x0000, 0x0000, 0x0000, 0x0000, 0x0000, 0x6000, 0xC000, 0x3000, 0x0000, 0x0000, 0x0C00, 0x6000, 0x0000, 0x6000, 0x0000, 0x067E, 0x0E0F, 0x03C6, 0x33F8
        dw 0x40C4, 0x1000, 0x3308, 0x8CC3, 0x0000, 0x70C0, 0x0000, 0x00C0, 0x0630, 0x0000, 0x0000, 0x0000, 0x0000, 0x0000, 0x0000, 0x0000, 0x0000, 0x0000, 0x0060, 0xC000, 0x3000, 0x0000, 0x0000, 0x0800, 0x6000, 0x0000, 0x6000, 0x0000, 0x0463, 0x1119, 0x8666, 0x3040
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        dw 0x0000, 0x0000, 0x0000, 0x0000, 0x0000, 0x0000, 0x0000, 0x0000, 0x0003, 0x8000, 0x3800, 0x0000, 0x0000, 0x0000, 0x0000, 0x0000, 0x0000, 0x01C0, 0x0000, 0x0000, 0x0000, 0x0000, 0x0000, 0x0000, 0x0000, 0x0000, 0x0000, 0x0180, 0x0000, 0x0000, 0x0000, 0x0000
COPY_WW equ 32
COPY_H  equ 15

cur_blk0:
        dw 0xC000, 0x0000
        dw 0xE000, 0x0000
        dw 0x79F0, 0x0000
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        dw 0x000A, 0xAAA0
cur_wht0:
        dw 0x0000, 0x0000
        dw 0x0000, 0x0000
        dw 0x0000, 0x0000
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        dw 0x0000, 0x0000
cur_blk1:
        dw 0xC000, 0x0000
        dw 0xE000, 0x000C
        dw 0x79FC, 0x001C
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        dw 0x0000, 0x0000
cur_wht1:
        dw 0x0000, 0x0000
        dw 0x0000, 0x0000
        dw 0x0000, 0x0000
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        dw 0x000A, 0xAAA0
cur_silh:
        dw 0xC000, 0x0000
        dw 0xE000, 0x000C
        dw 0x79FC, 0x001C
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        dw 0x000A, 0xAAA0
CUR_W   equ 30
CUR_H   equ 30
CUR_WW  equ 2

; category -> icon (main-menu order)
cat_tile: dw tile_cat_power, tile_cat_disp, tile_cat_dev, tile_cat_kbd, tile_cat_adv, tile_cat_dump, tile_cat_test, tile_cat_diag, tile_cat_backup, tile_cat_info

; per-item icon, indexed by global row number (rows[] order)
row_icon: dw tile_leaf, tile_moon, tile_mon_off, tile_gauge, tile_clam, tile_phone, tile_bat_bolt, tile_reset, tile_dualmon, tile_expand, tile_speaker, tile_wave, tile_speaker, tile_pen, tile_pen, tile_ir, tile_serial, tile_modem, tile_pccard, tile_speaker, tile_keyboard, tile_clock, tile_mouse, tile_mouse_mag, tile_printer, tile_hdd, tile_pccard, tile_pccard, tile_gauge, tile_battery, tile_floppy, tile_bolt, tile_netring, tile_link, tile_chip_dl, tile_chip_dl, tile_fontA, tile_chip_dl, tile_ram, tile_mon_color, tile_keyboard, tile_speaker, tile_clock, tile_timer, tile_mouse, tile_pen, tile_mag_list, tile_hdd_mag, tile_bat_mag, tile_card_mag, tile_chip_mag, tile_save_up, tile_save_dn, tile_bat_info, tile_gear_info, tile_tag, tile_power, tile_power, tile_reset

